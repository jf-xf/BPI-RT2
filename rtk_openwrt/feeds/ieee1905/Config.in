## rtk_openwrt/feeds/ieee1905/Config.in
```kconfig
if (PACKAGE_ieee1905)

menu "Configurations"

config IEEE1905_EXTENSION_ALLOWED
	bool "Allow plugins to extend 1905 CMDUs and/or TLVs"
	default y

config IEEE1905_PLATFORM_HAS_WIFI
	bool "Platform has WiFi"
	default y if PACKAGE_libwifi

endmenu
endif
```

## rtk_openwrt/feeds/map-topology/Config.in
```kconfig
if (PACKAGE_map-topology)

menu "Configurations"

config TOPOLOGYD_EASYMESH_VENDOR_EXT
	bool "Enable extra features through Easymesh vendor extension"
	default y

config TOPOLOGYD_EASYMESH_VENDOR_EXT_OUI_DEFAULT
	string
	default "\\\\x11\\\\x22\\\\x33"

config TOPOLOGYD_EASYMESH_VENDOR_EXT_OUI
	string "Vendor OUI in '\\\\xAB\\\\xCD\\\\xEF' format"
	default TOPOLOGYD_EASYMESH_VENDOR_EXT_OUI_DEFAULT
	help
	Extra features not covered by the base Easymesh specification can be
	enabled through TOPOLOGYD_EASYMESH_VENDOR_EXT. Please provide the Vendor's OUI
	through which such features would be exposed.

endmenu
endif
```

## rtk_openwrt/package/kernel/realtek/rtk_wifi6_ap/Config.in
```kconfig
menu "Realtek PCIE WiFi6 AP"
	depends on PACKAGE_kmod-rtk_wifi6_ap

config RTLWIFI6
	tristate
	default m
	select WIRELESS_EXT
	select WEXT_PRIV

source "Kconfig.openwrt"

config DMA_NONCOHERENT
     bool "Realtek WiFi non-cherent DMA"
     default n
     help
       Realtek Wlan device support non-cherent DMA.

config RTW_EFEM_IDENTIFY_WITH_FLASH
        bool "Enable WiFi-EFEM Identify With Flash Setting"
        default n
        help
            Help message of RTLWIFI6

config RTW_SW_LED_SHARED
	bool "Wifi shared LED support"
	default n
	help
		Help message of RTLWIFI6

choice SHARE_WHICH_WIFI_LED_CHOICE
	prompt "Share which Wi-Fi LED"
	depends on RTW_SW_LED_SHARED
	default RTW_SW_LED_SHARED_USING_2G
	help
		Help message of RTLWIFI6

config RTW_SW_LED_SHARED_USING_2G
	bool "Shared Wi-Fi 2.4G LED"

config RTW_SW_LED_SHARED_USING_5G
	bool "Shared Wi-Fi 5G LED"

endchoice

endmenu
```

## rtk_openwrt/package/realtek/librtk_timerlist/Config.in
```kconfig
menu "Reaktek Timer API Configuration"
	depends on PACKAGE_librtk_timerlist

#
config LIB_LIBRTK_TIMERLIST
	bool "RTK TIMER LIST Compiler Flag"
	default y
	help
		Now we usually use it for nflogd in systemd.

endmenu
```

## rtk_openwrt/package/realtek/multi-ap_release_ap/Config.in
```kconfig
config MULTI_AP_STP_SWITCH
	depends on PACKAGE_multi-ap_release_ap
	bool "STP monitor enable"
```

## rtk_openwrt/package/realtek/rtk_base/Config.in
```kconfig
menu "Realtek Startup Configuration features"
        depends on PACKAGE_rtk_base
		
	config LAN_PORT_NUM
		int "Lan Port Number"
		default 4

endmenu
```

## rtk_openwrt/package/realtek/rtk_igmpproxy/Config.in
```kconfig
menu "Realtek igmpproxy features"
        depends on PACKAGE_rtk_igmpproxy
		
	config USER_IGMPPROXY
		bool "use realtek igmpproxy"
		default y if PACKAGE_rtk_igmpproxy

	config USER_IGMPPROXY_SUPPORT_CFG_FILE
	depends on USER_IGMPPROXY
		bool "config igmpproxy with file"
		default n
endmenu
```
